## config/west.yml
```yaml
manifest:
  remotes:
    - name: zmkfirmware
      url-base: https://github.com/zmkfirmware
    - name: cornix
      url-base: https://github.com/KimMachineGun
  projects:
    - name: zmk
      remote: zmkfirmware
      revision: 904c9aec8822d79149d42c8a9a77e8828eb08f5a
      import: app/west.yml
    - name: zmk-keyboard-cornix
      remote: cornix
      revision: b661f3124451c1849bb30059d53b0d66f4edce2b
  self:
    path: config
```
